## sensor_node/main/Kconfig.projbuild
```kconfig
menu "_SensorNode"
    config I2C_MASTER_SCL
        int "SCL GPIO Num"
        default 19
        help
            GPIO number for I2C Master clock line.

    config I2C_MASTER_SDA
        int "SDA GPIO Num"
        default 18
        help
            GPIO number for I2C Master data line.

    config I2C_MASTER_PORT_NUM
        int "Port Number"
        default 1
        help
            Port number for I2C Master device.

    config I2C_MASTER_FREQUENCY
        int "Master Frequency"
        default 100000
        help
            I2C Speed of Master device.

    config ENABLE_DISPLAY
        bool "Enable Display"
        help
            Select this if this node will have a display attached to it

    config MESH_AP_PASSWD
        string "ap password"
        default "bungee123"
        help
            The mesh network id, same for all nodes in a single network

    config MESH_ROUTER_SSID
        string "SSID"
        help
            SSID for the mesh network

    config MESH_ROUTER_PASSWORD
        string "PASSWD"
        help
            password for the mesh network

    config MESH_AP_CONNECTIONS
        int "Max Connections"
        default 10
        help
            How many nodes will be in the network

    config MESH_CHANNEL
        int "Channel"
        default 1
        help
            The network channel for the router

    choice
        bool "Mesh AP Authentication Mode"
        default WIFI_AUTH_WPA2_PSK
        help
            Authentication mode.

        config WIFI_AUTH_OPEN
            bool "WIFI_AUTH_OPEN"
        config WIFI_AUTH_WPA_PSK
            bool "WIFI_AUTH_WPA_PSK"
        config WIFI_AUTH_WPA2_PSK
            bool "WIFI_AUTH_WPA2_PSK"
        config WIFI_AUTH_WPA_WPA2_PSK
            bool "WIFI_AUTH_WPA_WPA2_PSK"
    endchoice

    config MESH_AP_AUTHMODE
        int
        default 0 if WIFI_AUTH_OPEN
        default 2 if WIFI_AUTH_WPA_PSK
        default 3 if WIFI_AUTH_WPA2_PSK
        default 4 if WIFI_AUTH_WPA_WPA2_PSK
        help
            Mesh AP authentication mode.
endmenu
```
